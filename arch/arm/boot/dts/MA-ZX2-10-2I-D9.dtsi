// SPDX-License-Identifier: GPL-2.0+
/*
 *  Copyright (C) 2020 Enclustra GmbH
 *
 * This software is licensed under the terms of the GNU General Public
 * License version 2, as published by the Free Software Foundation, and
 * may be copied, distributed, and modified under those terms.
 *
 * This program is distributed in the hope that it will be useful,
 * but WITHOUT ANY WARRANTY; without even the implied warranty of
 * MERCHANTABILITY or FITNESS FOR A PARTICULAR PURPOSE.  See the
 * GNU General Public License for more details.
 */


#include "zynq-7000.dtsi"
#include "zynq_enclustra_common.dtsi"
#include "zynq_enclustra_mercury_zx2.dtsi"

/ {
	model = "Enclustra ZX2-10-2I-D9 SOM";

	memory {
		device_type = "memory";
		reg = <0x0 0x20000000>;
	};
};
