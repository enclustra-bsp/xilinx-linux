#include "zynq-7000.dtsi"
#include "zynq_enclustra_common.dtsi"
#include "zynq_enclustra_mercury_zx5.dtsi"

/ {
	model = "Enclustra ZX5-15-2I-D10 SOM";

	memory {
		device_type = "memory";
		reg = <0x0 0x40000000>;
	};
};
