#include "zynq-7000.dtsi"
#include "zynq_enclustra_common.dtsi"
#include "zynq_enclustra_mercury_zx1.dtsi"

/ {
	model = "Enclustra ZX5-30-3C-D10 SOM";

	chosen {
		bootargs = "console=ttyPS0,115200 earlycon root=/dev/mmcblk0p2 rw rootwait";
		stdout-path = "serial0:115200n8";
	};

	aliases {
		ethernet0 = &gem0;
		i2c0 = &i2c0;
		serial0 = &uart0;
		spi0 = &qspi;
	};

	memory {
		device_type = "memory";
		reg = <0x0 0x40000000>;
	};

/******************** PL entries **********************/

/******************** PL entries **********************/

};
