#include "zynqmp.dtsi"
#include "zynqmp-clk-ccf.dtsi"
#include "zynqmp_enclustra_common.dtsi"
#include "zynqmp_enclustra_mercury_xu1.dtsi"

/ {
	model = "Enclustra ME-XU1-15EG-1E-D12E-G1 SOM";

	memory {
		device_type = "memory";
		reg = <0x0 0x0 0x0 0x7ff00000>, <0x00000008 0x00000000 0x0 0x80000000>;
	};


/******************** PL entries **********************/

/* empty */
	
/******************** PL entries **********************/

};
