/ {
	model = "Enclustra ME-XU1-9EG-1E-D11E-G1 SOM";

	memory {
		device_type = "memory";
		reg = <0x0 0x0 0x0 0x7ff00000>;
	};


/******************** PL entries **********************/

/* empty */
	
/******************** PL entries **********************/

};
