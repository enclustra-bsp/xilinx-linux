#include "zynqmp.dtsi"
#include "zynqmp-clk-ccf.dtsi"
#include "zynqmp_enclustra_common.dtsi"
#include "zynqmp_enclustra_mercury_xu9.dtsi"

/ {
	model = "Enclustra XU9-5EV-1I-D12E-L11 SOM";

	memory {
		device_type = "memory";
		reg = <0x0 0x0 0x0 0x7ff00000>, <0x00000008 0x00000000 0x0 0x80000000>;
	};


/******************** PL entries **********************/

	amba_pl: amba_pl@0 {
		#address-cells = <2>;
		#size-cells = <2>;
		compatible = "simple-bus";
		ranges ;
		ddr4: ddr4@400000000 {
			compatible = "xlnx,ddr4-2.2";
			reg = <0x00000004 0x00000000 0x0 0x80000000>;
		};
	};
	
/******************** PL entries **********************/

};
