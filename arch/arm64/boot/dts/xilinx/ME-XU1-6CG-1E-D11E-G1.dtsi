/ {
	model = "Enclustra ME-XU1-6CG-1E-D11E-G1 SOM";

	memory {
		device_type = "memory";
		reg = <0x0 0x0 0x0 0x7ff00000>;
	};

	cpus {
		/delete-node/ cpu@2 ;
		/delete-node/ cpu@3 ;
	};

/******************** PL entries **********************/

/* empty */
	
/******************** PL entries **********************/

};
