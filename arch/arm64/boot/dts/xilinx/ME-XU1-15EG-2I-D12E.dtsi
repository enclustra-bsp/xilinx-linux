/ {
	model = "Enclustra ME-XU1-15EG-2I-D12E SOM";

	memory {
		device_type = "memory";
		reg = <0x0 0x0 0x0 0x7ff00000>, <0x00000008 0x00000000 0x0 0x80000000>;
	};


/******************** PL entries **********************/

/* empty */
	
/******************** PL entries **********************/

};
